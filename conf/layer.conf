## conf/layer.conf
```bitbake
# We have a conf and classes directory, add to BBPATH
BBPATH .= ":${LAYERDIR}"

# We have recipes-* directories, add to BBFILES
BBFILES += "${LAYERDIR}/recipes-*/*/*.bb \
            ${LAYERDIR}/recipes-*/*/*.bbappend"

BBFILE_COLLECTIONS += "meta-ghdemo"
BBFILE_PATTERN_meta-ghdemo = "^${LAYERDIR}/"
BBFILE_PRIORITY_meta-ghdemo = "6"

LAYERDEPENDS_meta-ghdemo = "core"
LAYERSERIES_COMPAT_meta-ghdemo = "kirkstone"
```
